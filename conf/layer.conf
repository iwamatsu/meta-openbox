## conf/layer.conf
```bitbake
# We have a conf and classes directory, add to BBPATH
BBPATH .= ":${LAYERDIR}"

# We have recipes-* directories, add to BBFILES
BBFILES += "${LAYERDIR}/recipes-*/*/*.bb \
            ${LAYERDIR}/recipes-*/*/*.bbappend"

BBFILE_COLLECTIONS += "openbox"
BBFILE_PATTERN_openbox = "^${LAYERDIR}/"
BBFILE_PRIORITY_openbox = "6"

LAYERDEPENDS_openbox = "core"
LAYERSERIES_COMPAT_openbox = "thud"
```
